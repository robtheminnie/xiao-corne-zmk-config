/ {
    chosen {
        /* Tell ZMK there is no physical keyboard matrix */
        zmk,keyboard = &empty_kscan;
    };
};

/ {
    /* Define a fake kscan device so ZMK doesn’t complain */
    empty_kscan: kscan {
        compatible = "zmk,kscan-empty";
        status = "okay";
    };
};

/* Enable USB HID for dongle */
&usbd {
    status = "okay";
};
